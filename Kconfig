## Kconfig
```kconfig
# Copyright (c) 2026 ErgoDox Wireless Project
# SPDX-License-Identifier: MIT

rsource "drivers/input/Kconfig"
```

## boards/shields/ergodox/Kconfig.defconfig
```kconfig
if SHIELD_ERGODOX_DONGLE

config ZMK_KEYBOARD_NAME
    default "ErgoDox"

config ZMK_SPLIT
    default y

config ZMK_SPLIT_ROLE_CENTRAL
    default y

config ZMK_SPLIT_BLE_CENTRAL_PERIPHERALS
    default 3

config BT_MAX_CONN
    default 8

config BT_MAX_PAIRED
    default 8

endif

if SHIELD_ERGODOX_LEFT

config ZMK_KEYBOARD_NAME
    default "ErgoDox Left"

config ZMK_SPLIT
    default y

config ZMK_SPLIT_ROLE_CENTRAL
    default n

endif

if SHIELD_ERGODOX_RIGHT

config ZMK_KEYBOARD_NAME
    default "ErgoDox Right"

config ZMK_SPLIT
    default y

config ZMK_SPLIT_ROLE_CENTRAL
    default n

endif

if SHIELD_ERGODOX_DONGLE_DISPLAY

config ZMK_KEYBOARD_NAME
    default "ErgoDox"

config ZMK_SPLIT
    default y

config ZMK_SPLIT_ROLE_CENTRAL
    default y

config ZMK_SPLIT_BLE_CENTRAL_PERIPHERALS
    default 3

config BT_MAX_CONN
    default 8

config BT_MAX_PAIRED
    default 8

endif

if SHIELD_ERGODOX_TOUCHPAD

config ZMK_KEYBOARD_NAME
    default "ErgoDox Touchpad"

config ZMK_SPLIT
    default y

config ZMK_SPLIT_ROLE_CENTRAL
    default n

endif
```

## boards/shields/ergodox/Kconfig.shield
```kconfig
config SHIELD_ERGODOX_LEFT
    def_bool $(shields_list_contains,ergodox_left)

config SHIELD_ERGODOX_RIGHT
    def_bool $(shields_list_contains,ergodox_right)

config SHIELD_ERGODOX_DONGLE
    def_bool $(shields_list_contains,ergodox_dongle)

config SHIELD_ERGODOX_DONGLE_DISPLAY
    def_bool $(shields_list_contains,ergodox_dongle_display)

config SHIELD_ERGODOX_TOUCHPAD
    def_bool $(shields_list_contains,ergodox_touchpad)
```

## drivers/input/Kconfig
```kconfig
# Copyright (c) 2026 ErgoDox Wireless Project
# SPDX-License-Identifier: MIT

menuconfig SYNAPTICS_TM_P3125
    bool "Synaptics TM-P3125 I2C-HID Touchpad driver"
    default y
    depends on DT_HAS_SYNAPTICS_TM_P3125_ENABLED
    select I2C
    select INPUT
    help
      Enable driver for Synaptics TM-P3125 I2C-HID touchpad sensor.
```

## dts/bindings/input/synaptics,tm-p3125.yaml
```yaml
# Copyright (c) 2026 ErgoDox Wireless Project
# SPDX-License-Identifier: MIT

description: Synaptics TM-P3125 I2C-HID Touchpad

compatible: "synaptics,tm-p3125"

include: [i2c-device.yaml]

properties:
  irq-gpios:
    type: phandle-array
    required: true
    description: GPIO pin connected to the touchpad INT line (Active-Low)
```
